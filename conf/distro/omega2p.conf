## conf/distro/omega2p.conf
```bitbake
# Based on Poky (Yocto Project Reference Distro)
require conf/distro/poky.conf

DISTRO = "omega2p"
DISTRO_NAME = "Onion Omega2+"

# Set systemd as init system
#DISTRO_FEATURES_append = " systemd"
#VIRTUAL-RUNTIME_init_manager = "systemd"
#DISTRO_FEATURES_BACKFILL_CONSIDERED = "sysvinit"
#VIRTUAL-RUNTIME_initscripts = ""

# Include build information under /etc/build
#INHERIT += "image-buildinfo"
#IMAGE_BUILDINFO_VARS = "DISTRO DISTRO_VERSION MACHINE"
```

## conf/layer.conf
```bitbake
# We have a conf and classes directory, add to BBPATH
BBPATH .= ":${LAYERDIR}"

# We have recipes-* directories, add to BBFILES
BBFILES += "${LAYERDIR}/recipes-*/*/*.bb \
            ${LAYERDIR}/recipes-*/*/*.bbappend"

BBFILE_COLLECTIONS += "omega2p"
BBFILE_PATTERN_omega2p = "^${LAYERDIR}/"
BBFILE_PRIORITY_omega2p = "6"

# This should only be incremented on significant changes that will
# cause compatibility issues with other layers
LAYERVERSION_omega2p = "1"
LAYERSERIES_COMPAT_omega2p = "warrior"
```

## conf/machine/omega2p.conf
```bitbake
#@TYPE: Machine
#@NAME: Onion Omega2+
#@SOC:  MediaTek MT7688
#@DESCRIPTION: Machine configuration for Onion Omega2+
#@MAINTAINER: Matija Tudan <tudan.matija@gmail.com>

require conf/machine/include/tune-mips32r2.inc

DEFAULTTUNE = "mips32r2el"

# Kernel provider
PREFERRED_PROVIDER_virtual/kernel = "linux-dummy"
#PREFERRED_VERSION_linux-yocto = "5.4%"

# U-Boot provider
#PREFERRED_PROVIDER_u-boot = "u-boot-omega2p"
#PREFERRED_PROVIDER_virtual/bootloader = "u-boot-omega2p"

# Debug UART
SERIAL_CONSOLES = "115200;ttyS0"

# Kernel config
#KERNEL_IMAGETYPE = "uImage"

# U-Boot config
#UBOOT_MAKE_TARGET = ""
#UBOOT_SUFFIX = "img"
#UBOOT_CONFIG ??= "sd "
# The above order matters:
# - the last one will be also called u-boot-${MACHINE}
# - and will be used to create the sdcard
#UBOOT_CONFIG[sd] = "omega2p_defconfig"
```
